## lp_blink/sdkconfig.defaults
```kconfig
CONFIG_ULP_COPROC_ENABLED=y
CONFIG_ULP_COPROC_TYPE_LP_CORE=y
CONFIG_ULP_COPROC_RESERVE_MEM=4096
CONFIG_ULP_SHARED_MEM=0x10

CONFIG_ULP_NORESET_UNDER_DEBUG=y
```
